/**
  *************************************************************************************************************************
  * @file    main.c
  * @author  amkl
  * @version V1.0
  * @date    2022-04-10
  * @brief   蓝桥嵌入式第十三届省赛
  *************************************************************************************************************************
  * @attention
  *
  *难点1."@"的切换，显示，处理
  *难点2.密码错误计数，超过三次后再次确认密码时，正确清零，错误保持闪烁报警
  *难点3.串口信息处理，字数串长度，格式，范围，密码输入是否正确等 
  *难点4.LED2闪烁处理，间隔0.1s亮灭，5s后熄灭处理。
  * 
  *************************************************************************************************************************
  */
/* Includes -------------------------------------------------------------------------------------------------------------*/
#include "myconfig.h"
/* 函数定义 -----------------------------------------------------------------------------------------------------------------*/
void All_Init(void);





int main(void)
{	
	All_Init();
	
	while(1)
	{	
		/* lcd-10ms刷新一次 */
		if(xDelay(TIMERINDEX1,1)  == TIMEISUP)
		{
			Lcd_Proc();
		}
		/* KEY-20ms扫描一次 */
		if(xDelay(TIMERINDEX2,2)  == TIMEISUP)
		{
			Key_Proc();
		}	
		/* LED-100ms检测一次 */
		if(xDelay(TIMERINDEX3,10)  == TIMEISUP)
		{
			Led2_Proc();
		}	
		/* UART-500ms检测一次 */
		if(xDelay(TIMERINDEX4,50)  == TIMEISUP)
		{
			Usart_Proc();
		}			
		Pwm_Proc();
	}
}

void All_Init(void)
{
 	NVIC_PriorityGroupConfig(NVIC_PriorityGroup_2);
  Delay_Init();	
	LED_Init();
	Key_Init();
	LCD_Init();
	Tim4_Init();
	TIM2_PWM_Init();
	Usart2_Init(); 
	SystemPara_Init();
}


/*****************************************************END OF FILE*********************************************************/	

